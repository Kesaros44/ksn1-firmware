#include "ksn_1.dtsi"

&default_transform {
    col-offset = <11>;
};

/ {
    encoder: encoder_right {
        compatible = "alps,ec11";
        a-gpios = <&gpio0 2  (GPIO_ACTIVE_HIGH | GPIO_PULL_UP)>;
        b-gpios = <&gpio0 29 (GPIO_ACTIVE_HIGH | GPIO_PULL_UP)>;
        steps = <80>;
        status = "okay";
    };

    sensors {
        compatible            = "zmk,keymap-sensors";
        sensors               = <&encoder>;
        triggers-per-rotation = <20>;
    };
};
