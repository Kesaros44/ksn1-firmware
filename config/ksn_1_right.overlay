/*
 * ksn_1_right.overlay — 슬레이브(오른쪽) 전용
 *
 * EC11 로터리 엔코더
 * EN1 = D19 = P0.02
 * EN2 = D20 = P0.29
 */

#include "ksn_1.dtsi"

/* 슬레이브 col 오프셋 (좌11 + 우11) */
&default_transform {
    col-offset = <11>;
};

/ {
    encoder: encoder_right {
        compatible = "alps,ec11";
        label      = "ENCODER_RIGHT";
        a-gpios    = <&gpio0 2  (GPIO_ACTIVE_HIGH | GPIO_PULL_UP)>;  /* EN1 D19 P0.02 */
        b-gpios    = <&gpio0 29 (GPIO_ACTIVE_HIGH | GPIO_PULL_UP)>;  /* EN2 D20 P0.29 */
        steps      = <80>;
        status     = "okay";
    };

    sensors {
        compatible            = "zmk,keymap-sensors";
        sensors               = <&encoder>;
        triggers-per-rotation = <20>;
    };
};
