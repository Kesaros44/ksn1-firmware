## config/Kconfig.defconfig
```kconfig
if SHIELD_KSN_1_LEFT || SHIELD_KSN_1_RIGHT

config ZMK_KEYBOARD_NAME
    default "KSN1"

config ZMK_SPLIT
    default y

endif
```

## config/Kconfig.shield
```kconfig
config SHIELD_KSN_1_LEFT
    def_bool $(shields_list_contains,ksn_1_left)

config SHIELD_KSN_1_RIGHT
    def_bool $(shields_list_contains,ksn_1_right)
```

## config/west.yml
```yaml
manifest:
  remotes:
    - name: zmkfirmware
      url-base: https://github.com/zmkfirmware
  projects:
    - name: zmk
      remote: zmkfirmware
      revision: main  # <--- v0.2에서 main으로 변경
      import: app/west.yml
  self:
    path: config
```
